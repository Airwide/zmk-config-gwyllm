## config/boards/shields/gwyllm/Kconfig.defconfig
```kconfig
if SHIELD_GWYLLM_LEFT

    config ZMK_KEYBOARD_NAME
        default "Gwyllm"

    config ZMK_SPLIT_BLE_ROLE_CENTRAL
        default y
endif

if SHIELD_GWYLLM_RIGHT

    config ZMK_KEYBOARD_NAME
        default "Gwyllm Right"

endif

if SHIELD_GWYLLM_LEFT || SHIELD_GWYLLM_RIGHT

    config ZMK_SPLIT
        default y

endif
```

## config/boards/shields/gwyllm/Kconfig.shield
```kconfig
config SHIELD_GWYLLM_LEFT
    def_bool $(shields_list_contains,gwyllm_left)

config SHIELD_GWYLLM_RIGHT
    def_bool $(shields_list_contains,gwyllm_right)
```
